## src/drivers/distance_sensor/ms53l2m/Kconfig
```kconfig
menuconfig DRIVERS_DISTANCE_SENSOR_MS53L2M
	bool "ms53l2m"
	default n
	---help---
		Enable support for ms53l2m
```

## src/drivers/magnetometer/mlx90393/Kconfig
```kconfig
menuconfig DRIVERS_MAGNETOMETER_MLX90393
	bool "mlx90393"
	default n
	---help---
		Enable support for mlx90393
```
